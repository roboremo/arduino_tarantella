
int sounder = 13; // output pin

// frequencies in tens of Hz
// and lengths in tens of ms
//                     |         |         |         |    |      |      |        |   |         |      |         |      |         |      |        |      |         |         |         |    |      |      |        |   |         |      |         |      |         |      |        |     |     |        |        |        |        |        |        |       |     |        |        |        |        |        |        |    |         |         |         |    |      |      |        |   |         |      |         |      |         |      |        |      |         |         |         |    |      |      |        |   |         |      |         |      |         |      |        |     |     |        |        |        |        |        |        |       |     |        |        |        |        |        |        |      |
const uint8_t ff1[] = {66,0,  66,49,0,  49,66,0,  66,49,  49, 49,52,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0,  66   };
const uint8_t ll1[] = {10,25, 15,15,15, 15,10,25, 15,50,  35, 15,35,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 50, 0};


void tone(uint16_t frq, uint16_t ms) {

  delay(5); // small pause

  if(frq==0) {
    
    delay(ms);
    
  } else {

    uint16_t period = 1000000/frq;
  
    uint16_t delay1 = period/2;
    uint16_t delay2 = period-delay1;
  
    uint16_t n = (1000L*ms)/period;
  
    for(uint16_t i=0; i<n; i++) {
      digitalWrite(sounder, HIGH);
      delayMicroseconds(delay1);
      digitalWrite(sounder, LOW);
      delayMicroseconds(delay2);
    }
    
  }
}


void setup() {
  pinMode(sounder, OUTPUT);
  digitalWrite(sounder, LOW);
}


uint8_t i, j;

void loop() {

   // find melody length, store in j:
   for(j=0; ll1[j]!=0; j++) {;}

   // play melody:
   for(i=0; i<j; i++)
      tone( ((uint16_t)ff1[i])*10, ((uint16_t)ll1[i])*10 );

   // 2s pause before repeating melody
   delay(2000);
        
}
